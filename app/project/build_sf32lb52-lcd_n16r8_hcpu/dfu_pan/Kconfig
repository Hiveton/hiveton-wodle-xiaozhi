## app/project/build_sf32lb52-lcd_n16r8_hcpu/dfu_pan/Kconfig
```kconfig
source "$SIFLI_SDK/Kconfig.v2"
source "$SIFLI_SDK/customer/boards/Kconfig.v2"
source "/Users/hiveton/HivetonCode/HivetonWodleXiaozhi/sdk/customer/boards/sf32lb52-lcd_n16r8/hcpu/Kconfig.board"
osource "/Users/hiveton/HivetonCode/HivetonWodleXiaozhi/sdk/example/dfu_pan/project/sf-pkgs/Kconfig.conandeps"
source "/Users/hiveton/HivetonCode/HivetonWodleXiaozhi/sdk/example/dfu_pan/project/Kconfig.proj"
```

## app/project/build_sf32lb52-lcd_n16r8_hcpu/dfu_pan/lcpu/Kconfig
```kconfig
source "$SIFLI_SDK/Kconfig.v2"
source "$SIFLI_SDK/customer/boards/Kconfig.v2"
source "/Users/hiveton/HivetonCode/HivetonWodleXiaozhi/sdk/customer/boards/sf32lb52-lcd_n16r8/lcpu/Kconfig.board"
osource "/Users/hiveton/HivetonCode/HivetonWodleXiaozhi/sdk/example/ble/lcpu_general/project/common/sf-pkgs/Kconfig.conandeps"
source "/Users/hiveton/HivetonCode/HivetonWodleXiaozhi/sdk/example/ble/lcpu_general/project/common/Kconfig.proj"
```
